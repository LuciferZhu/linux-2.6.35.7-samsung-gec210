## drivers/char/led/Kconfig
```kconfig
menu "leds drivers for gec210"

config GEC210_LEDS
	tristate "GEC210 leds drivers"
	default y
	depends on CPU_S5PV210
	help
	 this is a driver for LEDs on GEC210

endmenu
```

## drivers/spi/spi_board_info/Kconfig
```kconfig
menu "spi board info"
config GEC210_SPI_BOARD_INFO
	tristate "gec210 spi board info"
	default n
	depends on SPI && CPU_S5PV210
	help
		for gec210 board-specific as spi board info
endmenu
```
